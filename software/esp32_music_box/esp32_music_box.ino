#include "music.h"
#include <WiFi.h>

WiFiUDP Udp;

const char* wifi_SSID="Music_Box";  //存储AP的名称信息
const char* wifi_Password="del123456";  //存储AP的密码信息

uint16_t udp_port=1122;  //存储需要监听的端口号

char PROGMEM incomingPacket[65536];  //存储Udp客户端发过来的数据
uint16_t Data_length,len;
int commaPosition;
String message_udp,inString;

uint32_t PROGMEM melody[1031] = {
0,
1,
NOTE_G4,//5  
NOTE_G4,//5
NOTE_A4,//6
NOTE_G4,//5
NOTE_C5,//1.
NOTE_B4,//7
0,
NOTE_G4,//5
NOTE_G4,//5
NOTE_A4,//6
NOTE_G4,//5
NOTE_D5,//2.
NOTE_C5,//1.
0,
NOTE_G4,//5
NOTE_G4,//5
NOTE_G5,//5.
NOTE_E5,//3.
NOTE_C5,//1.
NOTE_B4,//7
NOTE_A4,//6
0,
NOTE_F5,//4.
NOTE_F5,//4.
NOTE_E5,//3.
NOTE_C5,//1.
NOTE_D5,//2.
NOTE_C5,//1.
0,
0,0,0,0,0,0,0,0,0,0,
0,0,0,0,0,0,0,0,0,0,
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0,0,0,0,0,0,0,0,0,0, //1000个0
};

//Duration time of each melody
float noteDurations[] = {
  4,
  4,
  0.5,0.5,1,1,1,1,
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0,0,0,0,0,0,0,0,0,0, //1000个0
};

uint16_t length_a;//这里定义一个变量，后面用来表示共有多少个音符
int tonePin=12;//蜂鸣器的pin
uint16_t duration = 500;

void setup() {
  // put your setup code here, to run once:
//  WiFi.softAP(wifi_SSID,wifi_Password);  //打开ESP32热点
//  Udp.begin(udp_port);//启动UDP监听这个端口

  Serial.begin(115200);

  WiFi.begin(wifi_SSID,wifi_Password);
  while (WiFi.status() != WL_CONNECTED) {
    delay(500);
  }
  Serial.println(WiFi.localIP());
  Udp.begin(udp_port);//启动UDP监听这个端口
  ledcSetup(0,1,8);
  ledcAttachPin(tonePin,0);
  ledcWrite(0,0);

  length_a = 29;//这里用了一个sizeof函数，可以查出tone序列里有多少个音符
}

void loop() {
  udp_read();
  duration = 2000 / noteDurations[0];
  if(melody[0] == 1){
    for(int x=2;x<length_a;x++)//循环音符的次数
    {
      if(melody[x] != 0){
        ledcWriteTone(0,melody[x]);
        ledcWrite(0,0x7F);
      }
      else{
        ledcWriteTone(0,1);
        ledcWrite(0,0);
      }
//      int noteDuration = 4000/noteDurations[x];
      uint32_t noteDuration = duration*noteDurations[x];
      delay(noteDuration);
      ledcWrite(0,0);
//      ledcWrite(0,-1);
//      ledcWriteTone(0,-1);
      uint32_t pauseBetweenNotes = noteDuration * 0.30;
      delay(pauseBetweenNotes);
    }
    for(int cc = 1;cc<length_a;cc++){
      Serial.print(noteDurations[cc]);
      Serial.print(",");
    }
    Serial.println("");
    delay(3000);//等待5秒后，循环重新开始
  }
}
